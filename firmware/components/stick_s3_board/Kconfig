## firmware/components/stick_s3_board/Kconfig
```kconfig
menu "AgentStick board"

choice AGENTSTICK_BOARD
    prompt "AgentStick hardware board"
    default AGENTSTICK_BOARD_M5STACK_STICKS3
    help
        Select the ESP32-S3 board variant used by this firmware build.

config AGENTSTICK_BOARD_M5STACK_STICKS3
    bool "M5Stack StickS3"

config AGENTSTICK_BOARD_LICHUANG_ESP32S3
    bool "Lichuang ESP32-S3 development board"

endchoice

endmenu
```
