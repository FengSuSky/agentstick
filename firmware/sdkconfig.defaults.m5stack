## firmware/sdkconfig.defaults.m5stack
```kconfig
CONFIG_AGENTSTICK_BOARD_M5STACK_STICKS3=y
CONFIG_ESPTOOLPY_FLASHSIZE_8MB=y
CONFIG_ESPTOOLPY_FLASHSIZE="8MB"
CONFIG_PARTITION_TABLE_CUSTOM_FILENAME="partitions_m5stack.csv"
CONFIG_PARTITION_TABLE_FILENAME="partitions_m5stack.csv"
```
